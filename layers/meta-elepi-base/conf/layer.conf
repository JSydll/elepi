## layers/meta-elepi-base/conf/layer.conf
```bitbake
BBPATH .= ":${LAYERDIR}"
BBFILES += "${LAYERDIR}/recipes-*/*/*.bb \
            ${LAYERDIR}/recipes-*/*/*.bbappend"

BBFILE_COLLECTIONS += "meta-elepi-base"
BBFILE_PATTERN_meta-elepi-base = "^${LAYERDIR}/"
BBFILE_PRIORITY_meta-elepi-base = "6"

BBFILES_DYNAMIC += " \
    meta-rauc-raspberrypi:${LAYERDIR}/dynamic-layers/meta-rauc-raspberrypi/recipes-*/*/*.bbappend \
    meta-rauc-qemuarm:${LAYERDIR}/dynamic-layers/meta-rauc-qemuarm/recipes-*/*/*.bbappend \
"

LAYERDEPENDS_meta-elepi-base = "core meta-python"
LAYERSERIES_COMPAT_meta-elepi-base = "styhead"

# Layer globals
ELEPI_USER     = "somebody"
ELEPI_GROUP    = "elepi"
ELEPI_UID      = "2000"
ELEPI_GID      = "4000"
ELEPI_PASSWORD = "\$6\$KY9zTzkzQnAgtJfM\$i/r4jxewUsHWJBRgQ.0d2Y4YI8x45bzE53xySGpw4WVBcGgp6BZQgXlOLnObL2rDSZx/LDDvsb6yTeKR00zvq."
```

## layers/meta-elepi-base/wic/qemuarm-dualboot-ro-rootfs.wks
```
bootloader --ptable gpt

part /boot --ondisk vda --source bootimg-partition --fstype=vfat --active --fixed-size 16M --label bootfiles --align 4096
part / --ondisk vda --source rootfs --fstype=squashfs --align 4096 --fixed-size 250M
part / --ondisk vda --source empty --fstype=squashfs --align 4096 --fixed-size 250M
part /data --ondisk vda --fstype=ext4 --size 100M --label data
```

## layers/meta-elepi-userspace-odyssey/conf/layer.conf
```bitbake
BBPATH .= ":${LAYERDIR}"
BBFILES += "${LAYERDIR}/recipes-*/*/*.bb \
            ${LAYERDIR}/recipes-*/*/*.bbappend"

BBFILE_COLLECTIONS += "meta-elepi-userspace-odyssey"
BBFILE_PATTERN_meta-elepi-userspace-odyssey = "^${LAYERDIR}/"
BBFILE_PRIORITY_meta-elepi-userspace-odyssey = "8"

LAYERDEPENDS_meta-elepi-userspace-odyssey = "core meta-elepi-base"
LAYERSERIES_COMPAT_meta-elepi-userspace-odyssey = "styhead"
```
